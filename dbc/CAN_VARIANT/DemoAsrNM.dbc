VERSION ""

NS_ :

BS_:

BU_: Node_D Gateway Node_C Node_B Node_A

BO_ 1365 NM_Msg_Gateway: 8 Gateway

BO_ 259 ApplMsg_D: 4 Node_D
 SG_ ApplSignal : 0|32@1+ (1,0) [0|0] "" Vector__XXX

BO_ 1348 NM_Msg_D: 8 Node_D

BO_ 1331 NM_Msg_C: 8 Node_C

BO_ 1314 NM_Msg_B: 8 Node_B

BO_ 1297 NM_Msg_A: 8 Node_A

BO_ 258 ApplMsg_C: 4 Node_C
 SG_ ApplSignal : 0|32@1+ (1,0) [0|0] "" Vector__XXX

BO_ 257 ApplMsg_B: 4 Node_B
 SG_ ApplSignal : 0|32@1+ (1,0) [0|0] "" Vector__XXX

BO_ 256 ApplMsg_A: 4 Node_A
 SG_ ApplSignal : 0|32@1+ (1,0) [0|0] "" Vector__XXX

CM_ BO_ 259 "Just an application message.";
CM_ BO_ 258 "Just an application message.";
CM_ BO_ 257 "Just an application message.";
CM_ BO_ 256 "Just an application message.";
BA_DEF_ BO_  "NmAsrMessage" ENUM  "No","Yes";
BA_DEF_  "NmAsrTimeoutTime" INT 0 0;
BA_DEF_  "NmAsrWaitBusSleepTime" INT 0 0;
BA_DEF_  "NmAsrRepeatMessageTime" INT 0 0;
BA_DEF_ SG_  "GenSigSendType" ENUM  "Cyclic","OnWrite","OnWriteWithRepetition","OnChange","OnChangeWithRepetition","IfActive","IfActiveWithRepetition","NoSigSendType","NotUsed","NotUsed","NotUsed","NotUsed","NotUsed";
BA_DEF_ BO_  "GenMsgSendType" ENUM  "Cyclic","NotUsed","NotUsed","NotUsed","NotUsed","NotUsed","NotUsed","IfActive","NoMsgSendType","NotUsed","vector_leerstring";
BA_DEF_ BO_  "GenMsgCycleTime" INT 0 50000;
BA_DEF_ BO_  "GenMsgILSupport" ENUM  "No","Yes";
BA_DEF_  "NmAsrCanMsgCycleTime" INT 0 0;
BA_DEF_ BU_  "NmAsrCanMsgReducedTime" INT 0 0;
BA_DEF_ BU_  "NodeLayerModules" STRING ;
BA_DEF_ BU_  "NmAsrNodeIdentifier" HEX 0 255;
BA_DEF_  "NmAsrMessageCount" INT 1 128;
BA_DEF_  "NmAsrBaseAddress" HEX 0 536870911;
BA_DEF_  "BusType" STRING ;
BA_DEF_DEF_  "NmAsrMessage" "No";
BA_DEF_DEF_  "NmAsrTimeoutTime" 2000;
BA_DEF_DEF_  "NmAsrWaitBusSleepTime" 1500;
BA_DEF_DEF_  "NmAsrRepeatMessageTime" 3200;
BA_DEF_DEF_  "GenSigSendType" "Cyclic";
BA_DEF_DEF_  "GenMsgSendType" "NoMsgSendType";
BA_DEF_DEF_  "GenMsgCycleTime" 0;
BA_DEF_DEF_  "GenMsgILSupport" "Yes";
BA_DEF_DEF_  "NmAsrCanMsgCycleTime" 640;
BA_DEF_DEF_  "NmAsrCanMsgReducedTime" 6400;
BA_DEF_DEF_  "NodeLayerModules" "AsrNM33.DLL,CANoeILNLVector.DLL";
BA_DEF_DEF_  "NmAsrNodeIdentifier" 0;
BA_DEF_DEF_  "NmAsrMessageCount" 64;
BA_DEF_DEF_  "NmAsrBaseAddress" 1280;
BA_DEF_DEF_  "BusType" "CAN";
BA_ "NmAsrMessageCount" 128;
BA_ "NmAsrCanMsgReducedTime" BU_ Node_D 640;
BA_ "NmAsrNodeIdentifier" BU_ Node_D 68;
BA_ "NodeLayerModules" BU_ Gateway "AsrNM33.DLL";
BA_ "NmAsrCanMsgReducedTime" BU_ Gateway 640;
BA_ "NmAsrNodeIdentifier" BU_ Gateway 85;
BA_ "NmAsrCanMsgReducedTime" BU_ Node_C 550;
BA_ "NmAsrNodeIdentifier" BU_ Node_C 51;
BA_ "NmAsrCanMsgReducedTime" BU_ Node_B 450;
BA_ "NmAsrNodeIdentifier" BU_ Node_B 34;
BA_ "NmAsrCanMsgReducedTime" BU_ Node_A 350;
BA_ "NmAsrNodeIdentifier" BU_ Node_A 17;
BA_ "NmAsrMessage" BO_ 1365 1;
BA_ "GenMsgILSupport" BO_ 1365 0;
BA_ "GenMsgCycleTime" BO_ 259 500;
BA_ "GenMsgSendType" BO_ 259 0;
BA_ "NmAsrMessage" BO_ 1348 1;
BA_ "GenMsgILSupport" BO_ 1348 0;
BA_ "NmAsrMessage" BO_ 1331 1;
BA_ "GenMsgILSupport" BO_ 1331 0;
BA_ "NmAsrMessage" BO_ 1314 1;
BA_ "GenMsgILSupport" BO_ 1314 0;
BA_ "NmAsrMessage" BO_ 1297 1;
BA_ "GenMsgILSupport" BO_ 1297 0;
BA_ "GenMsgCycleTime" BO_ 258 500;
BA_ "GenMsgSendType" BO_ 258 0;
BA_ "GenMsgCycleTime" BO_ 257 500;
BA_ "GenMsgSendType" BO_ 257 0;
BA_ "GenMsgCycleTime" BO_ 256 500;
BA_ "GenMsgSendType" BO_ 256 0;
