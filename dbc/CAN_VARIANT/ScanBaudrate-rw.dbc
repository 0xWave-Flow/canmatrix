VERSION "TOOL OF INVENTEC AND KOSTAL"

NS_ :

BS_:

BU_: Scanner

BO_ 291 EngineState: 2 Scanner
 SG_ EngineSpeed : 1|15@1- (1,0) [0|0] "rpm"  Vector__XXX
 SG_ OnOff : 0|1@1+ (1,0) [0|0] ""  Vector__XXX
