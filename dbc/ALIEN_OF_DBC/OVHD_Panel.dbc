VERSION ""

NS_ :

BS_:

BU_: FuelPanel
VAL_TABLE_ FMS_PushButtonStates 1 "On" 0 "Off" ;
VAL_TABLE_ FMS_SSM 3 "Failure Warning " 2 "Functional Test" 1 "NCD" 0 "Normal Operation " ;
VAL_TABLE_ FMS_SDI 2 "Computer 2" 1 "Computer 1" ;
VAL_TABLE_ FMS_Pump_States 1 "Off" 0 "Energized" ;
VAL_TABLE_ vt_BNRaccuracy 1 "Degraded Accuracy" 0 "Nominal Accuracy" ;
VAL_TABLE_ vt_BCDstatus_above_below 3 "Below" 2 "FT (functional test)" 1 "NCD (no computed data)" 0 "Above" ;
VAL_TABLE_ vt_BCDstatus_to_from 3 "From" 2 "FT (functional test)" 1 "NCD (no computed data)" 0 "To" ;
VAL_TABLE_ vt_BCDstatus_right_left 3 "Left" 2 "FT (functional test)" 1 "NCD (no computed data)" 0 "Right" ;
VAL_TABLE_ vt_BCDstatus_east_west 3 "West" 2 "FT (functional test)" 1 "NCD (no computed data)" 0 "East" ;
VAL_TABLE_ vt_BCDstatus_north_south 3 "South" 2 "FT (functional test)" 1 "NCD (no computed data)" 0 "North" ;
VAL_TABLE_ vt_BCDstatus_plus_minus 3 "Minus" 2 "FT (functional test)" 1 "NCD (no computed data)" 0 "Plus" ;
VAL_TABLE_ vt_DSCstatus 3 "FW (failure warning)" 2 "FT (functional test)" 1 "NCD (no computed data)" 0 "NO (normal operation)" ;
VAL_TABLE_ vt_BNRsign_above_below 1 "Below" 0 "Above" ;
VAL_TABLE_ vt_BNRsign_to_from 1 "From" 0 "To" ;
VAL_TABLE_ vt_BNRsign_right_left 1 "Left" 0 "Right" ;
VAL_TABLE_ vt_BNRsign_east_west 1 "West" 0 "East" ;
VAL_TABLE_ vt_BNRsign_north_south 1 "South" 0 "North" ;
VAL_TABLE_ vt_BNRsign_plus_minus 1 "Minus" 0 "Plus" ;
VAL_TABLE_ vt_BNRstatus 3 "NO (normal operation)" 2 "FT (functional test)" 1 "NCD (no computed data)" 0 "FW (failure warning)" ;

BO_ 97 Pump_Contactor_And_Pushbutton_St: 4 FuelPanel
 SG_ SSM_141 : 29|2@1+ (1,0) [0|3] "" Vector__XXX
 SG_ SDI_141 : 8|2@1+ (1,0) [0|3] "" Vector__XXX
 SG_ Standby_Pump_1_Pushbutton : 14|1@1+ (1,0) [0|1] "" Vector__XXX
 SG_ Standby_Pump_4_Pushbutton : 20|1@1+ (1,0) [0|1] "" Vector__XXX
 SG_ Standby_Pump_3_Pushbutton : 18|1@1+ (1,0) [0|1] "" Vector__XXX
 SG_ Standby_Pump_2_Pushbutton : 16|1@1+ (1,0) [0|1] "" Vector__XXX
 SG_ APU_Pump_Contactor : 12|1@1+ (1,0) [0|1] "" Vector__XXX
 SG_ Center_Tank_Left_Transfer_Pump_P : 21|1@1+ (1,0) [0|1] "" Vector__XXX
 SG_ RCT_Transfer_Pump_B_Rear_Contact : 11|1@1+ (1,0) [0|1] "" Vector__XXX
 SG_ RCT_Transfer_Pump_A_Front_Contac : 10|1@1+ (1,0) [0|1] "" Vector__XXX
 SG_ Main_Pump_4_Pushbutton : 19|1@1+ (1,0) [0|1] "" Vector__XXX
 SG_ Main_Pump_3_Pushbutton : 17|1@1+ (1,0) [0|1] "" Vector__XXX
 SG_ Main_Pump_2_Pushbutton : 15|1@1+ (1,0) [0|1] "" Vector__XXX
 SG_ Main_Pump_1_Pushbutton : 13|1@1+ (1,0) [0|1] "" Vector__XXX
 SG_ RCT_Transfer_Pump_B_Rear_Pushbut : 28|1@1+ (1,0) [0|1] "" Vector__XXX
 SG_ RCT_Transfer_Pump_A_Front_Pushbu : 27|1@1+ (1,0) [0|1] "" Vector__XXX
 SG_ Trim_Tank_Right_Transfer_Pump_Pu : 26|1@1+ (1,0) [0|1] "" Vector__XXX
 SG_ Trim_Tank_Left_Transfer_Pump_Pus : 25|1@1+ (1,0) [0|1] "" Vector__XXX
 SG_ Center_Tank_Right_Aft_Transfer_P : 24|1@1+ (1,0) [0|1] "" Vector__XXX
 SG_ Center_Tank_Left_Aft_Transfer_Pu : 23|1@1+ (1,0) [0|1] "" Vector__XXX
 SG_ Center_Tank_Right_Transfer_Pump_ : 22|1@1+ (1,0) [0|1] "" Vector__XXX

CM_ SG_ 97 SDI_141 "Source/Destination Identifier";
BA_DEF_  "ProtocolType" STRING ;
BA_DEF_ BO_  "A429SpecSource" ENUM  "ARINC","GAMA","Private";
BA_DEF_ BO_  "A429Protocol" ENUM  "BC","AIM","A619","WB1","WB2","WB3";
BA_DEF_ SG_  "A429SignalType" ENUM  "none","BCD","BNR","DISCRETE","ISO-5","SSM","SDI";
BA_DEF_  "A429Parity" ENUM  "unknown","odd","even";
BA_DEF_ BO_  "A429CycleMax" INT 0 0;
BA_DEF_ BO_  "A429Cycle" INT 0 0;
BA_DEF_ BO_  "A429CycleMin" INT 0 0;
BA_DEF_ BU_  "A429Equipment" STRING ;
BA_DEF_  "Baudrate" INT 10500 110000;
BA_DEF_  "ToolName" STRING ;
BA_DEF_  "ToolVersion" STRING ;
BA_DEF_  "Manufacturer" STRING ;
BA_DEF_  "VersionDay" INT 0 31;
BA_DEF_  "VersionMonth" INT 0 12;
BA_DEF_  "VersionWeek" INT 0 0;
BA_DEF_  "BusType" STRING ;
BA_DEF_ SG_  "SystemSignalLongSymbol" STRING ;
BA_DEF_ BO_  "SystemMessageLongSymbol" STRING ;
BA_DEF_DEF_  "ProtocolType" "Aerospace";
BA_DEF_DEF_  "A429SpecSource" "ARINC";
BA_DEF_DEF_  "A429Protocol" "BC";
BA_DEF_DEF_  "A429SignalType" "BNR";
BA_DEF_DEF_  "A429Parity" "odd";
BA_DEF_DEF_  "A429CycleMax" 0;
BA_DEF_DEF_  "A429Cycle" 0;
BA_DEF_DEF_  "A429CycleMin" 0;
BA_DEF_DEF_  "A429Equipment" "<unknown>";
BA_DEF_DEF_  "Baudrate" 100000;
BA_DEF_DEF_  "ToolName" "manually";
BA_DEF_DEF_  "ToolVersion" "x.y.z.n";
BA_DEF_DEF_  "Manufacturer" "<unknown>";
BA_DEF_DEF_  "VersionDay" 1;
BA_DEF_DEF_  "VersionMonth" 1;
BA_DEF_DEF_  "VersionWeek" 1;
BA_DEF_DEF_  "BusType" "ARINC429";
BA_DEF_DEF_  "SystemSignalLongSymbol" "";
BA_DEF_DEF_  "SystemMessageLongSymbol" "";
BA_ "A429Equipment" BU_ FuelPanel "114";
BA_ "A429Cycle" BO_ 97 200000;
BA_ "A429CycleMax" BO_ 97 100000;
BA_ "A429CycleMin" BO_ 97 400000;
BA_ "SystemMessageLongSymbol" BO_ 97 "Pump_Contactor_And_Pushbutton_States";
BA_ "SystemSignalLongSymbol" SG_ 97 Center_Tank_Left_Transfer_Pump_P "Center_Tank_Left_Transfer_Pump_Pushbutton";
BA_ "SystemSignalLongSymbol" SG_ 97 RCT_Transfer_Pump_B_Rear_Contact "RCT_Transfer_Pump_B_Rear_Contactor";
BA_ "SystemSignalLongSymbol" SG_ 97 RCT_Transfer_Pump_A_Front_Contac "RCT_Transfer_Pump_A_Front_Contactor";
BA_ "SystemSignalLongSymbol" SG_ 97 RCT_Transfer_Pump_B_Rear_Pushbut "RCT_Transfer_Pump_B_Rear_Pushbutton";
BA_ "SystemSignalLongSymbol" SG_ 97 RCT_Transfer_Pump_A_Front_Pushbu "RCT_Transfer_Pump_A_Front_Pushbutton";
BA_ "SystemSignalLongSymbol" SG_ 97 Trim_Tank_Right_Transfer_Pump_Pu "Trim_Tank_Right_Transfer_Pump_Pushbutton";
BA_ "SystemSignalLongSymbol" SG_ 97 Trim_Tank_Left_Transfer_Pump_Pus "Trim_Tank_Left_Transfer_Pump_Pushbutton";
BA_ "SystemSignalLongSymbol" SG_ 97 Center_Tank_Right_Aft_Transfer_P "Center_Tank_Right_Aft_Transfer_Pump_PSHBTN";
BA_ "SystemSignalLongSymbol" SG_ 97 Center_Tank_Left_Aft_Transfer_Pu "Center_Tank_Left_Aft_Transfer_Pump_PSHBTN";
BA_ "SystemSignalLongSymbol" SG_ 97 Center_Tank_Right_Transfer_Pump_ "Center_Tank_Right_Transfer_Pump_Pushbutton";
VAL_ 97 SSM_141 3 "Failure Warning " 2 "Functional Test" 1 "NCD" 0 "Normal Operation " ;
VAL_ 97 SDI_141 2 "Computer 2" 1 "Computer 1" ;
VAL_ 97 Standby_Pump_1_Pushbutton 1 "On" 0 "Off" ;
VAL_ 97 Standby_Pump_4_Pushbutton 1 "On" 0 "Off" ;
VAL_ 97 Standby_Pump_3_Pushbutton 1 "On" 0 "Off" ;
VAL_ 97 Standby_Pump_2_Pushbutton 1 "On" 0 "Off" ;
VAL_ 97 APU_Pump_Contactor 1 "Off" 0 "Energized" ;
VAL_ 97 Center_Tank_Left_Transfer_Pump_P 1 "On" 0 "Off" ;
VAL_ 97 RCT_Transfer_Pump_B_Rear_Contact 1 "Off" 0 "Energized" ;
VAL_ 97 RCT_Transfer_Pump_A_Front_Contac 1 "Off" 0 "Energized" ;
VAL_ 97 Main_Pump_4_Pushbutton 1 "On" 0 "Off" ;
VAL_ 97 Main_Pump_3_Pushbutton 1 "On" 0 "Off" ;
VAL_ 97 Main_Pump_2_Pushbutton 1 "On" 0 "Off" ;
VAL_ 97 Main_Pump_1_Pushbutton 1 "On" 0 "Off" ;
VAL_ 97 RCT_Transfer_Pump_B_Rear_Pushbut 1 "On" 0 "Off" ;
VAL_ 97 RCT_Transfer_Pump_A_Front_Pushbu 1 "On" 0 "Off" ;
VAL_ 97 Trim_Tank_Right_Transfer_Pump_Pu 1 "On" 0 "Off" ;
VAL_ 97 Trim_Tank_Left_Transfer_Pump_Pus 1 "On" 0 "Off" ;
VAL_ 97 Center_Tank_Right_Aft_Transfer_P 1 "On" 0 "Off" ;
VAL_ 97 Center_Tank_Left_Aft_Transfer_Pu 1 "On" 0 "Off" ;
VAL_ 97 Center_Tank_Right_Transfer_Pump_ 1 "On" 0 "Off" ;
